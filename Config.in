## Config.in
```kconfig
source "$BR2_EXTERNAL_hlk7628n_PATH/linux/Config.in"

source "$BR2_EXTERNAL_hlk7628n_PATH/package/openwrt-patches/Config.in"
source "$BR2_EXTERNAL_hlk7628n_PATH/package/lzma-old/Config.in"
source "$BR2_EXTERNAL_hlk7628n_PATH/package/swconfig/Config.in"
source "$BR2_EXTERNAL_hlk7628n_PATH/package/mac80211_nodrv/Config.in"
source "$BR2_EXTERNAL_hlk7628n_PATH/package/mt76-mt76x8/Config.in"
```

## hlk-7628n_defconfig
```kconfig
# base config, mipsel_24kc
BR2_mipsel=y
BR2_mips_32r2=y

BR2_REPRODUCIBLE=y
BR2_GLOBAL_PATCH_DIR="${BR2_EXTERNAL_hlk_7628n_PATH}/patches"

# toolchain
BR2_TOOLCHAIN_USES_MUSL=y

BR2_TOOLCHAIN_EXTERNAL=y
BR2_TOOLCHAIN_EXTERNAL_CUSTOM=y
BR2_TOOLCHAIN_EXTERNAL_CUSTOM_MUSL=y
BR2_TOOLCHAIN_EXTERNAL_GCC_10=y
BR2_TOOLCHAIN_EXTERNAL_HEADERS_4_19=y
BR2_TOOLCHAIN_EXTERNAL_CUSTOM_PREFIX="mipsel-nerves-linux-musl"
BR2_TOOLCHAIN_EXTERNAL_CXX=y

BR2_TOOLCHAIN_EXTERNAL_DOWNLOAD=y
BR2_TOOLCHAIN_EXTERNAL_URL="https://github.com/nerves-project/toolchains/releases/download/v1.5.0/nerves_toolchain_mipsel_nerves_linux_musl-linux_x86_64-1.5.0-139CB15.tar.xz"

# kernel related config
BR2_LINUX_KERNEL=y
BR2_LINUX_KERNEL_CUSTOM_VERSION=y
BR2_LINUX_KERNEL_CUSTOM_VERSION_VALUE="5.4.154"
BR2_LINUX_KERNEL_PATCH="${BR2_EXTERNAL_hlk_7628n_PATH}/linux/patches"
BR2_LINUX_KERNEL_USE_CUSTOM_CONFIG=y
BR2_LINUX_KERNEL_CUSTOM_CONFIG_FILE="${BR2_EXTERNAL_hlk_7628n_PATH}/linux/linux-5.4.defconfig"
BR2_LINUX_KERNEL_XZ=y
BR2_LINUX_KERNEL_DTS_SUPPORT=y
BR2_LINUX_KERNEL_CUSTOM_DTS_PATH="${BR2_EXTERNAL_hlk_7628n_PATH}/linux/dts/mt7628an.dtsi ${BR2_EXTERNAL_hlk_7628n_PATH}/linux/dts/mt7628an_hilink_hlk-7628n.dts"

BR2_LINUX_KERNEL_UIMAGE=y

# rootfs
BR2_ROOTFS_SKELETON_DEFAULT=y
BR2_INIT_BUSYBOX=y

BR2_TARGET_ROOTFS_SQUASHFS=y
BR2_TARGET_ROOTFS_SQUASHFS_PAD=y
BR2_TARGET_ROOTFS_SQUASHFS4_XZ=y
```

## hlk7628n_defconfig
```kconfig
BR2_mipsel=y
BR2_mips_32r2=y
BR2_GLOBAL_PATCH_DIR="${BR2_EXTERNAL_hlk7628n_PATH}/patches"
BR2_REPRODUCIBLE=y
BR2_TOOLCHAIN_EXTERNAL=y
BR2_TOOLCHAIN_EXTERNAL_CUSTOM=y
BR2_TOOLCHAIN_EXTERNAL_DOWNLOAD=y
BR2_TOOLCHAIN_EXTERNAL_URL="https://github.com/nerves-project/toolchains/releases/download/v1.5.0/nerves_toolchain_mipsel_nerves_linux_musl-linux_x86_64-1.5.0-139CB15.tar.xz"
BR2_TOOLCHAIN_EXTERNAL_CUSTOM_PREFIX="mipsel-nerves-linux-musl"
BR2_TOOLCHAIN_EXTERNAL_GCC_10=y
BR2_TOOLCHAIN_EXTERNAL_HEADERS_4_19=y
BR2_TOOLCHAIN_EXTERNAL_CUSTOM_MUSL=y
BR2_TOOLCHAIN_EXTERNAL_CXX=y
BR2_LINUX_KERNEL=y
BR2_LINUX_KERNEL_CUSTOM_VERSION=y
BR2_LINUX_KERNEL_CUSTOM_VERSION_VALUE="5.4.154"
BR2_LINUX_KERNEL_PATCH="${BR2_EXTERNAL_hlk7628n_PATH}/linux/patches"
BR2_LINUX_KERNEL_USE_CUSTOM_CONFIG=y
BR2_LINUX_KERNEL_CUSTOM_CONFIG_FILE="${BR2_EXTERNAL_hlk7628n_PATH}/linux/linux-5.4.defconfig"
BR2_LINUX_KERNEL_VMLINUX_BIN=y
BR2_LINUX_KERNEL_XZ=y
BR2_LINUX_KERNEL_DTS_SUPPORT=y
BR2_LINUX_KERNEL_CUSTOM_DTS_PATH="${BR2_EXTERNAL_hlk7628n_PATH}/linux/dts/mt7628an.dtsi ${BR2_EXTERNAL_hlk7628n_PATH}/linux/dts/mt7628an_hilink_hlk-7628n.dts"
BR2_PACKAGE_FWUP=y
BR2_PACKAGE_MTD=y
# BR2_PACKAGE_MTD_FLASHCP is not set
# BR2_PACKAGE_MTD_FLASH_ERASE is not set
# BR2_PACKAGE_MTD_FLASH_LOCK is not set
# BR2_PACKAGE_MTD_FLASH_UNLOCK is not set
BR2_PACKAGE_MTD_MKFSJFFS2=y
# BR2_PACKAGE_MTD_NANDDUMP is not set
# BR2_PACKAGE_MTD_NANDTEST is not set
# BR2_PACKAGE_MTD_NANDWRITE is not set
# BR2_PACKAGE_MTD_UBIATTACH is not set
# BR2_PACKAGE_MTD_UBICRC32 is not set
# BR2_PACKAGE_MTD_UBIDETACH is not set
# BR2_PACKAGE_MTD_UBIFORMAT is not set
# BR2_PACKAGE_MTD_UBIHEALTHD is not set
# BR2_PACKAGE_MTD_UBIMKVOL is not set
# BR2_PACKAGE_MTD_UBINFO is not set
# BR2_PACKAGE_MTD_UBINIZE is not set
# BR2_PACKAGE_MTD_UBIRENAME is not set
# BR2_PACKAGE_MTD_UBIRMVOL is not set
# BR2_PACKAGE_MTD_UBIRSVOL is not set
# BR2_PACKAGE_MTD_UBIUPDATEVOL is not set
# BR2_PACKAGE_MTD_UBIBLOCK is not set
BR2_TARGET_ROOTFS_SQUASHFS=y
BR2_TARGET_ROOTFS_SQUASHFS4_XZ=y
BR2_PACKAGE_HOST_FWUP=y
BR2_PACKAGE_HOST_MTD=y
BR2_PACKAGE_HOST_UBOOT_TOOLS=y
BR2_LINUX_KERNEL_EXT_OPENWRT_PATCHES=y
BR2_LINUX_KERNEL_EXT_OPENWRT_PATCHES_RAMIPS=y
BR2_PACKAGE_HOST_LZMA_OLD=y
```

## linux/Config.in
```kconfig
menu "Linux Kernel OpenWRT Extensions"

# openwrt generic
config BR2_LINUX_KERNEL_EXT_OPENWRT_PATCHES
	bool "OpenWRT generic patches"
    select BR2_PACKAGE_OPENWRT_PATCHES
	help
	  Add OpenWRT generic patches

if BR2_LINUX_KERNEL_EXT_OPENWRT_PATCHES
# openwrt ramips
config BR2_LINUX_KERNEL_EXT_OPENWRT_PATCHES_RAMIPS
    bool "OpenWRT ramips patches"
	help
	  Add OpenWRT generic patches
endif

endmenu
```

## package/mt76-mt76x8/Config.in
```kconfig
config BR2_PACKAGE_MT76_MT76X8
    bool "MediaTek MT76x8 wireless driver"
    select BR2_PACKAGE_MAC80211_NODRV
	help
	  MediaTek MT76x8 wireless driver, from OpenWRT mt76 repo.
```

## package/openwrt-patches/Config.in
```kconfig
config BR2_PACKAGE_OPENWRT_PATCHES
    bool
    depends on BR2_LINUX_KERNEL
	help
	  OpenWrt kernel patches
```

## package/swconfig/Config.in
```kconfig
config BR2_PACKAGE_SWCONFIG
	bool "swconfig from OpenWRT"
	select BR2_PACKAGE_LIBNL
	select BR2_PACKAGE_LIBUBOX
	help
		OpenWRT swconfig binary, remove uci dependency
```
